## sdkconfig.defaults
```kconfig
# FreeRTOS Configuration
CONFIG_FREERTOS_HZ=1000
CONFIG_FREERTOS_UNICORE=n

# UART Configuration
CONFIG_UART1_BAUD_RATE=921600

# Wi-Fi Configuration
CONFIG_ESP32_WIFI_STATIC_RX_BUFFER_NUM=10
CONFIG_ESP32_WIFI_DYNAMIC_RX_BUFFER_NUM=32

# Logging
CONFIG_LOG_DEFAULT_LEVEL_INFO=y
CONFIG_LOG_MAXIMUM_LEVEL_VERBOSE=y

# ESP32 CPU Frequency
CONFIG_ESP32_DEFAULT_CPU_FREQ_240=y

# Task Watchdog (optional, but recommended)
CONFIG_ESP_TASK_WDT=y
CONFIG_ESP_TASK_WDT_TIMEOUT_S=10
```
